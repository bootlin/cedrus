## buildroot/configs/libva_defconfig
```kconfig
BR2_arm=y
BR2_cortex_a8=y
BR2_TOOLCHAIN_EXTERNAL=y
BR2_TOOLCHAIN_EXTERNAL_CUSTOM=y
BR2_TOOLCHAIN_EXTERNAL_GCC_7=y
BR2_TOOLCHAIN_EXTERNAL_HEADERS_4_9=y
BR2_TOOLCHAIN_EXTERNAL_CUSTOM_GLIBC=y
BR2_PACKAGE_LIBVA_CEDRUS_DRIVER=y
```

## buildroot/configs/libva_toolchain_defconfig
```kconfig
BR2_arm=y
BR2_cortex_a8=y
BR2_TOOLCHAIN_BUILDROOT_GLIBC=y
BR2_PACKAGE_HOST_LINUX_HEADERS_CUSTOM_4_9=y
BR2_GCC_VERSION_7_X=y
BR2_TOOLCHAIN_BUILDROOT_CXX=y
BR2_LINUX_KERNEL=y
BR2_LINUX_KERNEL_CUSTOM_VERSION=y
BR2_LINUX_KERNEL_CUSTOM_VERSION_VALUE="4.9"
BR2_LINUX_KERNEL_PATCH="$(BR2_EXTERNAL_CEDRUS_PATH)/../patches/4.9"
BR2_LINUX_KERNEL_DEFCONFIG="multi_v7"
```

## buildroot/package/libva-cedrus-driver/Config.in
```kconfig
config BR2_PACKAGE_LIBVA_CEDRUS_DRIVER
	bool "libva-cedrus-driver"
	select BR2_PACKAGE_LIBVA
	select BR2_PACKAGE_XLIB_LIBX11
	select BR2_PACKAGE_XORG7
```
